## thingy-53-matter-machine-learning/sample.yaml
```yaml
sample:
  name: nRF Machine Learning
  description: Machine learning application reference design
tests:
  applications.machine_learning.zdebug:
    build_only: true
    platform_allow: thingy53_nrf5340_cpuapp
    integration_platforms:
      - thingy53_nrf5340_cpuapp
    tags: ci_build
  applications.machine_learning.zdebug_rtt:
    build_only: true
    platform_allow: thingy53_nrf5340_cpuapp
    integration_platforms:
      - thingy53_nrf5340_cpuapp
    tags: ci_build
    extra_args: CONF_FILE=prj_rtt.conf
  applications.machine_learning.zrelease:
    build_only: true
    platform_allow: thingy53_nrf5340_cpuapp
    integration_platforms:
      - thingy53_nrf5340_cpuapp
    tags: ci_build
    extra_args: CONF_FILE=prj_release.conf
```
